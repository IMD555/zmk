/*
 * Copyright (c) 2024 The ZMK Contributors
 *
 * SPDX-License-Identifier: MIT
 */

/ {
    behaviors {
        /omit-if-no-ref/ ind: led_indicators {
            compatible = "zmk,behavior-led-indicators";
            #binding-cells = <2>;
        };
    };
};
