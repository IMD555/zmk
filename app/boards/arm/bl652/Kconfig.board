## app/boards/arm/bl652/Kconfig.board
```kconfig
# Copyright (c) 2024 The ZMK Contributors
# SPDX-License-Identifier: MIT

config BOARD_BL652
    bool "bl652"
    depends on SOC_NRF52832_QFAA
```

## app/boards/arm/bl652/Kconfig.defconfig
```kconfig
# Copyright (c) 2024 The ZMK Contributors
# SPDX-License-Identifier: MIT

if BOARD_BL652

config ZMK_KEYBOARD_NAME
    default "bl652"

config BT_CTLR
    default BT

endif # BOARD_BL652
```

## app/boards/arm/thin_minila/thin_minila_defconfig
```kconfig
# Copyright (c) 2021 Nick Winans
# SPDX-License-Identifier: MIT

CONFIG_SOC_SERIES_NRF52X=y
CONFIG_SOC_NRF52832_QFAA=y
CONFIG_BOARD_THIN_MINILA=y

# Enable MPU
CONFIG_ARM_MPU=y

CONFIG_PINCTRL=y

# enable GPIO
CONFIG_GPIO=y

CONFIG_CLOCK_CONTROL_NRF_K32SRC_XTAL=y
CONFIG_CLOCK_CONTROL_NRF_K32SRC_150PPM=y

CONFIG_USE_DT_CODE_PARTITION=y

CONFIG_MPU_ALLOW_FLASH_WRITE=y
CONFIG_NVS=y
CONFIG_SETTINGS_NVS=y
CONFIG_FLASH=y
CONFIG_FLASH_PAGE_LAYOUT=y
CONFIG_FLASH_MAP=y

CONFIG_ZMK_BLE=y
```

## app/boards/shields/huit_macropad/Kconfig.defconfig
```kconfig
# Copyright (c) 2022 The ZMK Contributors
# SPDX-License-Identifier: MIT

if SHIELD_HUITMACROPAD

config ZMK_KEYBOARD_NAME
    default "huit_macropad"

endif
```

## app/boards/shields/huit_macropad/Kconfig.shield
```kconfig
# Copyright (c) 2022 The ZMK Contributors
# SPDX-License-Identifier: MIT

config SHIELD_HUITMACROPAD
   def_bool $(shields_list_contains,huit_macropad)
```

## app/boards/shields/imd555/Kconfig.defconfig
```kconfig
# Copyright (c) 2024 The ZMK Contributors
# SPDX-License-Identifier: MIT

if SHIELD_MINILA_BLE

config ZMK_KEYBOARD_NAME
    default "Minila BLE"

config LED
    default y

config LED_INDICATOR_SHORT_ON_MS
    int "Duration of BLE connection status blink in ms"
    default 100

config LED_INDICATOR_LONG_ON_MS
    int "Duration of BLE connection status blink in ms"
    default 500

config LED_INDICATOR_INTERVAL_MS
    int "Minimum wait duration between two blinks in ms"
    default 200

config LED_INDICATOR_BATTERY_LEVEL_CRITICAL
    int "Critical battery level percentage"
    default 5

endif

if SHIELD_THIN_MINILA

config ZMK_KEYBOARD_NAME
    default "Thin-Minila"

config LED
    default y

config LED_INDICATOR_SHORT_ON_MS
    int "Duration of BLE connection status blink in ms"
    default 100

config LED_INDICATOR_LONG_ON_MS
    int "Duration of BLE connection status blink in ms"
    default 500

config LED_INDICATOR_INTERVAL_MS
    int "Minimum wait duration between two blinks in ms"
    default 200

config LED_INDICATOR_BATTERY_LEVEL_CRITICAL
    int "Critical battery level percentage"
    default 5

endif

if SHIELD_MACRO_PAD

config ZMK_KEYBOARD_NAME
    default "Macro-Pad"

config LED
    default y

config LED_INDICATOR_SHORT_ON_MS
    int "Duration of BLE connection status blink in ms"
    default 100

config LED_INDICATOR_LONG_ON_MS
    int "Duration of BLE connection status blink in ms"
    default 500

config LED_INDICATOR_INTERVAL_MS
    int "Minimum wait duration between two blinks in ms"
    default 200

config LED_INDICATOR_BATTERY_LEVEL_CRITICAL
    int "Critical battery level percentage"
    default 5

endif

if SHIELD_MACRO_PAD2_3D

config ZMK_KEYBOARD_NAME
    default "Macro-Pad2-3D"

config LED
    default y

config LED_INDICATOR_SHORT_ON_MS
    int "Duration of BLE connection status blink in ms"
    default 100

config LED_INDICATOR_LONG_ON_MS
    int "Duration of BLE connection status blink in ms"
    default 500

config LED_INDICATOR_INTERVAL_MS
    int "Minimum wait duration between two blinks in ms"
    default 200

config LED_INDICATOR_BATTERY_LEVEL_CRITICAL
    int "Critical battery level percentage"
    default 5

endif
```

## app/boards/shields/imd555/Kconfig.shield
```kconfig
# Copyright (c) 2024 The ZMK Contributors
# SPDX-License-Identifier: MIT

config SHIELD_MINILA_BLE
    def_bool $(shields_list_contains,minila_ble)

config SHIELD_THIN_MINILA
    def_bool $(shields_list_contains,thin_minila)
    
config SHIELD_MACRO_PAD
    def_bool $(shields_list_contains,macro_pad)
    
config SHIELD_MACRO_PAD2_3D
    def_bool $(shields_list_contains,macro_pad2_3d)
    
```

## app/dts/bindings/behaviors/zmk,behavior-led-indicators.yaml
```yaml
# Copyright (c) 2024 The ZMK Contributors
# SPDX-License-Identifier: MIT

description: LED indicators Behavior

compatible: "zmk,behavior-led-indicators"

include: two_param.yaml
```

## app/dts/bindings/behaviors/zmk,behavior-selector.yaml
```yaml
# Copyright (c) 2024 The ZMK Contributors
# SPDX-License-Identifier: MIT

description: Selector Behavior

compatible: "zmk,behavior-selector"

include: one_param.yaml

properties:
  bindings:
    type: phandle-array
    required: true
  tap_ms:
    type: int
    default: 5
  selection-default:
    type: int
    default: 0
  loop:
    type: boolean
  separate-pushed:
    type: boolean
```

## app/module/dts/bindings/sensor/zmk,battery-nrf-vdd.yaml
```yaml
# Copyright (c) 2021 The ZMK Contributors
# SPDX-License-Identifier: MIT

description: Battery SoC monitoring using nRF VDD

compatible: "zmk,battery-nrf-vdd"
```
